## conf/bblayers.conf
```bitbake
# POKY_BBLAYERS_CONF_VERSION is increased each time build/conf/bblayers.conf
# changes incompatibly
POKY_BBLAYERS_CONF_VERSION = "2"

BBPATH = "${TOPDIR}"
BBFILES ?= ""

BBLAYERS ?= " \
  /media/venom/XXX/Yocto-G/poky/meta \
  /media/venom/XXX/Yocto-G/poky/meta-poky \
  /media/venom/XXX/Yocto-G/poky/meta-yocto-bsp \
  /media/venom/XXX/Yocto-G/meta-raspberrypi \
  /media/venom/XXX/Yocto-G/meta-openembedded/meta-xfce \
  /media/venom/XXX/Yocto-G/meta-openembedded/meta-perl \
  /media/venom/XXX/Yocto-G/meta-openembedded/meta-python \
  /media/venom/XXX/Yocto-G/meta-openembedded/meta-webserver \
  /media/venom/XXX/Yocto-G/meta-openembedded/meta-multimedia \
  /media/venom/XXX/Yocto-G/meta-openembedded/meta-networking \
  /media/venom/XXX/Yocto-G/meta-openembedded/meta-oe \
  /media/venom/XXX/Yocto-G/meta-openembedded/meta-filesystems \
  /media/venom/XXX/Yocto-G/meta-openembedded/meta-gnome \
  /media/venom/XXX/Yocto-G/meta-openembedded/meta-initramfs \
  /media/venom/XXX/Yocto-G/meta-rust \
  /media/venom/XXX/Yocto-G/meta-clang \
  /media/venom/XXX/Yocto-G/meta-qt5 \
  /media/venom/XXX/Yocto-G/meta-qt5-extra \
  /media/venom/XXX/Yocto-G/meta-retro \
  /media/venom/XXX/Yocto-G/meta-python2 \
  /media/venom/XXX/Yocto-G/meta-java \
  /media/venom/XXX/Yocto-G/meta-security \
  /media/venom/XXX/Yocto-G/meta-browser/meta-chromium \
  /media/venom/XXX/Yocto-G/meta-ros/meta-ros1 \   
  /media/venom/XXX/Yocto-G/meta-ros/meta-ros-common \   
  /media/venom/XXX/Yocto-G/meta-ros/meta-ros1-melodic \   
  /media/venom/XXX/Yocto-G/meta-ros/meta-ros-python2 \  
  /media/venom/XXX/Yocto-G/meta-gstreamer1.0 \
  /media/venom/XXX/Yocto-G/meta-venom \
  /media/venom/XXX/Yocto-G/meta-swupdate \
  "
```
